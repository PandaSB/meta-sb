## conf/layer.conf
```bitbake
# We have a conf and classes directory, append to BBPATH
BBPATH .= ":${LAYERDIR}"

# We have a recipes directory containing .bb and .bbappend files, add to BBFILES
BBFILES += "${LAYERDIR}/recipes*/*/*.bb \
            ${LAYERDIR}/images*/*.bb \
            ${LAYERDIR}/recipes*/*/*.bbappend \
            ${LAYERDIR}/images*/*.bbappend \
"

BBFILE_COLLECTIONS += "sb"
BBFILE_PATTERN_sb := "^${LAYERDIR}/"
BBFILE_PRIORITY_sb = "15"

#LAYERSERIES_COMPAT_sb = "styhead walnascar"
LAYERDEPENDS_sb = "core"

# Additional license directories.
LICENSE_PATH += "${LAYERDIR}/files/custom-licenses"

LAYERSERIES_COMPAT_sb = "walnascar"
```
